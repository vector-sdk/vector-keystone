## overlays/keystone/toolchain/keystone-bootrom-toolchain/Config.in.host
```kconfig
config BR2_TARGET_HOST_KEYSTONE_BOOTROM_TOOLCHAIN
	bool "Keystone boot ROM toolchain"
	help
	  This toolchain is used to compile Keystone boot ROM image.
```

## overlays/vector/Config.in
```kconfig
menu "Rust packages"
    source "$BR2_EXTERNAL_VECTOR_PATH/package/rust-sdk/Config.in.host"
    source "$BR2_EXTERNAL_VECTOR_PATH/package/rust-sdk-demo/Config.in.host"
    source "$BR2_EXTERNAL_VECTOR_PATH/package/static-dh-ecdh/Config.in.host"
    source "$BR2_EXTERNAL_VECTOR_PATH/package/schannel-demo/Config.in.host"
    source "$BR2_EXTERNAL_VECTOR_PATH/package/wasm-demo/Config.in.host"
    source "$BR2_EXTERNAL_VECTOR_PATH/package/wasm-examples/Config.in.host"
endmenu
```

## overlays/vector/package/rust-sdk-demo/Config.in.host
```kconfig
config BR2_PACKAGE_HOST_RUST_SDK_DEMO
	bool "Rust SDK for Keystone"
	depends on BR2_PACKAGE_HOST_RUST_SDK
	select BR2_PACKAGE_HOST_RUSTC
	help
	  Install Rust SDK demonstrator
```

## overlays/vector/package/rust-sdk/Config.in.host
```kconfig
config BR2_PACKAGE_HOST_RUST_SDK
	bool "Rust SDK for Keystone"
	select BR2_PACKAGE_HOST_RUSTC
	help
	  Install Rust SDK for Keystone
```

## overlays/vector/package/schannel-demo/Config.in.host
```kconfig
config BR2_PACKAGE_HOST_SCHANNEL_DEMO
	bool "Secure channel Rust SDK demo for Keystone"
	depends on BR2_PACKAGE_HOST_RUST_SDK
	select BR2_PACKAGE_HOST_RUSTC
	select BR2_PACKAGE_HOST_STATIC_DH_ECDH
	help
	  Install secure channel demo that is using Rust SDK.
```

## overlays/vector/package/static-dh-ecdh/Config.in.host
```kconfig
config BR2_PACKAGE_HOST_STATIC_DH_ECDH
	bool "Elliptic curve Diffie-Hellman library"
	select BR2_PACKAGE_HOST_RUSTC
	help
	  Install no_std compatible Rust-based elliptic curve
	  Diffie-Hellman library.
```

## overlays/vector/package/wasm-demo/Config.in.host
```kconfig
config BR2_PACKAGE_HOST_WASM_DEMO
	bool "Secure channel Web Assembly demo for Keystone"
	depends on BR2_PACKAGE_HOST_RUST_SDK
	select BR2_PACKAGE_HOST_RUSTC
	select BR2_PACKAGE_HOST_STATIC_DH_ECDH
	help
	  Install Web Assembly demo that is using Rust SDK.
```

## overlays/vector/package/wasm-examples/Config.in.host
```kconfig
config BR2_PACKAGE_HOST_WASM_EXAMPLES
	bool "Build and install Web Assembly examples"
	help
	  Install Web Assembly examples to root user's home directory.
```
